## CMakeLists.txt
```
cmake_minimum_required(VERSION 3.20.0)
find_package(Zephyr REQUIRED HINTS $ENV{ZEPHYR_BASE})
project(noeud)
target_sources(app PRIVATE src/main.c src/mqtt.c)
```

## prj.conf
```kconfig
CONFIG_CAN=y
CONFIG_NETWORKING=y
CONFIG_NET_IPV4=y
CONFIG_NET_SOCKETS=y
CONFIG_NET_DRIVERS=y
CONFIG_NET_SOCKETS_OFFLOAD=y
CONFIG_NET_NATIVE_OFFLOADED_SOCKETS=y
CONFIG_MQTT_LIB=y
```

## src/main.c
```c
#include <zephyr/kernel.h>
#include <zephyr/sys/printk.h>
#include <zephyr/drivers/can.h>
#include "sample.h"

#define PERIOD_MS     20     /* mets 20 pour le test 1 */
#define NB_SAMPLES    5000
#define STACK_SIZE    1024
#define CAN_ID_MESURE 0x123


K_MSGQ_DEFINE(sample_q, sizeof(struct sample), 8, 4); 
K_MSGQ_DEFINE(mqtt_q, sizeof(struct sample), 256, 4);   /* ~5 s de tampon à 20 ms */
uint32_t mqtt_dropped;

static uint32_t dropped;
static uint32_t can_errors;
static uint32_t sent;
static int64_t max_send_us;

static void acquisition(void *a, void *b, void *c)
{
	int64_t period = k_ms_to_ticks_ceil64(PERIOD_MS);
	int64_t next = k_uptime_ticks() + period;

	for (uint32_t i = 0; i < NB_SAMPLES; i++) {
		k_sleep(K_TIMEOUT_ABS_TICKS(next));

		struct sample s = { .seq = i, .value = 20 + (int32_t)(i % 10) };

		if (k_msgq_put(&sample_q, &s, K_NO_WAIT) != 0) {
			dropped++;
		}
		if (k_msgq_put(&mqtt_q, &s, K_NO_WAIT) != 0) {
			mqtt_dropped++;
		}
		next += period;
	}

	printk("Fin : %u perdues, %u erreurs CAN, %u envoyees, can_send max %lld us\n",
	       dropped, can_errors, sent, max_send_us);
	printk("Fin mqtt: %u perdues, %u  pubs, %u reconnects\n",
	       mqtt_dropped, mqtt_published, mqtt_reconnects);
}

static void can_thread(void *a, void *b, void *c)
{
	const struct device *can_dev = DEVICE_DT_GET(DT_CHOSEN(zephyr_canbus));
	struct sample s;
	int ret;

	if (!device_is_ready(can_dev)) {
		printk("Controleur CAN non pret\n");
		return;
	}

	ret = can_start(can_dev);
	if (ret != 0 && ret != -EALREADY) {
		printk("can_start a echoue : %d\n", ret);
		return;
	}

	while (1) {
		k_msgq_get(&sample_q, &s, K_FOREVER);

		struct can_frame frame = {
			.id = CAN_ID_MESURE,
			.dlc = 3,
			.flags = 0,
		};
		frame.data[0] = s.seq & 0xFF;          /* numero, poids faible */
		frame.data[1] = (s.seq >> 8) & 0xFF;   /* numero, poids fort */
		frame.data[2] = (uint8_t)s.value;      /* valeur de la mesure */

		int64_t t0 = k_uptime_ticks();
		ret = can_send(can_dev, &frame, K_MSEC(10), NULL, NULL);
		int64_t d = k_ticks_to_us_near64(k_uptime_ticks() - t0);

		if (d > max_send_us) {
			max_send_us = d;
		}
		if (ret != 0) {
			can_errors++;

		} else {
			sent++;
		}
	}
}

K_THREAD_DEFINE(acq_tid, STACK_SIZE, acquisition, NULL, NULL, NULL, 5, 0, 0);
K_THREAD_DEFINE(can_tid, STACK_SIZE, can_thread, NULL, NULL, NULL, 6, 0, 0);

int main(void)
{
	return 0;
}
```

## src/mqtt.c
```c
#include <zephyr/kernel.h>
#include <zephyr/net/socket.h>
#include <zephyr/net/mqtt.h>
#include <errno.h>
#include <stdio.h>
#include <string.h>
#include "sample.h"

#define BROKER_ADDR    "127.0.0.1"
#define BROKER_PORT    1883
#define TOPIC          "noeud/mesures"
#define BACKOFF_MIN_MS 500
#define BACKOFF_MAX_MS 8000

static uint8_t rx_buf[256];
static uint8_t tx_buf[256];
static struct mqtt_client client;
static struct sockaddr_storage broker;
static volatile bool connected;

uint32_t mqtt_published;
uint32_t mqtt_reconnects;

static void evt_handler(struct mqtt_client *c, const struct mqtt_evt *evt)
{
        switch (evt->type) {
        case MQTT_EVT_CONNACK:
                connected = (evt->result == 0);
                break;
        case MQTT_EVT_DISCONNECT:
                connected = false;
                break;
        default:
                break;
        }
}

static int broker_connect(void)
{
        struct sockaddr_in *b = (struct sockaddr_in *)&broker;

        memset(&broker, 0, sizeof(broker));
        b->sin_family = AF_INET;
        b->sin_port = htons(BROKER_PORT);
        zsock_inet_pton(AF_INET, BROKER_ADDR, &b->sin_addr);

        mqtt_client_init(&client);
        client.broker = &broker;
        client.evt_cb = evt_handler;
        client.client_id.utf8 = (uint8_t *)"noeud_zephyr";
        client.client_id.size = sizeof("noeud_zephyr") - 1;
        client.protocol_version = MQTT_VERSION_3_1_1;
        client.keepalive = 5;
        client.rx_buf = rx_buf;
        client.rx_buf_size = sizeof(rx_buf);
        client.tx_buf = tx_buf;
        client.tx_buf_size = sizeof(tx_buf);
        client.transport.type = MQTT_TRANSPORT_NON_SECURE;

        connected = false;
        int rc = mqtt_connect(&client);
        if (rc != 0) {
                return rc;
        }

        struct zsock_pollfd fds = {
                .fd = client.transport.tcp.sock,
                .events = ZSOCK_POLLIN,
        };
        rc = zsock_poll(&fds, 1, 2000);
        if (rc > 0) {
                mqtt_input(&client);    /* traite le CONNACK */
        }
        if (!connected) {
                mqtt_abort(&client);
                return -ECONNREFUSED;
        }
        return 0;
}

static int publish_sample(const struct sample *s)
{
        char payload[48];
        int len = snprintf(payload, sizeof(payload),
                           "{\"seq\":%u,\"value\":%d}", s->seq, s->value);

        struct mqtt_publish_param p = {
                .message.topic.qos = MQTT_QOS_0_AT_MOST_ONCE,
                .message.topic.topic.utf8 = (uint8_t *)TOPIC,
                .message.topic.topic.size = sizeof(TOPIC) - 1,
                .message.payload.data = (uint8_t *)payload,
                .message.payload.len = len,
                .message_id = (uint16_t)s->seq,
        };
        return mqtt_publish(&client, &p);
}

/* Boucle en mode normal : sort des que la connexion tombe */
static void session(void)
{
        struct sample s;

        while (connected) {
                /* peek : l'echantillon ne quitte la file qu'apres publication reussie */
                if (k_msgq_peek(&mqtt_q, &s) == 0) {
                        if (publish_sample(&s) != 0) {
                                break;
                        }
                        k_msgq_get(&mqtt_q, &s, K_NO_WAIT);
                        mqtt_published++;
                } else {
                        k_sleep(K_MSEC(5));
                }

                struct zsock_pollfd fds = {
                        .fd = client.transport.tcp.sock,
                        .events = ZSOCK_POLLIN,
                };
                int rc = zsock_poll(&fds, 1, 0);

                if (rc > 0) {
                        if ((fds.revents & (ZSOCK_POLLHUP | ZSOCK_POLLERR |
                                            ZSOCK_POLLNVAL)) ||
                            mqtt_input(&client) != 0) {
                                break;
                        }
                }

                rc = mqtt_live(&client);
                if (rc != 0 && rc != -EAGAIN) {
                        break;
                }
        }
}

static void mqtt_thread(void *a, void *b, void *c)
{
        uint32_t backoff = BACKOFF_MIN_MS;

        while (1) {
                if (broker_connect() == 0) {
                        printk("MQTT connecte\n");
                        backoff = BACKOFF_MIN_MS;
                        session();
                        mqtt_abort(&client);
                        mqtt_reconnects++;
                        printk("MQTT deconnecte : mode degrade, %u mesures en attente\n",
                               k_msgq_num_used_get(&mqtt_q));
                } else {
                        printk("MQTT injoignable, nouvel essai dans %u ms\n", backoff);
                }
                k_sleep(K_MSEC(backoff));
                backoff = MIN(backoff * 2, BACKOFF_MAX_MS);
        }
}

K_THREAD_DEFINE(mqtt_tid, 4096, mqtt_thread, NULL, NULL, NULL, 7, 0, 0);
```

## src/sample.h
```c
#ifndef SAMPLE_H
#define SAMPLE_H

#include <zephyr/kernel.h>

struct sample {
        uint32_t seq;
        int32_t value;
};

extern struct k_msgq mqtt_q;
extern uint32_t mqtt_dropped;
extern uint32_t mqtt_published;
extern uint32_t mqtt_reconnects;

#endif
```
